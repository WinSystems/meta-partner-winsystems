## conf/layer.conf
```bitbake
# We might have a conf and classes directory, append to BBPATH
BBPATH .= ":${LAYERDIR}"

# We have a recipes directory, add to BBFILES
BBFILES += "${LAYERDIR}/recipes*/*/*.bb ${LAYERDIR}/recipes*/*/*.bbappend"

BBFILE_COLLECTIONS += "meta-partner-winsystems"
BBFILE_PATTERN_meta-partner-winsystems := "^${LAYERDIR}/"
BBFILE_PRIORITY_meta-partner-winsystems = "9"

LAYERDEPENDS_meta-partner-winsystems = "meta-lmp-base"
LAYERSERIES_COMPAT_meta-partner-winsystems = "honister kirkstone"
```

## conf/machine/imx8mq-itx-p-c444-ebbr.conf
```bitbake
#@TYPE: Machine
#@NAME: WINSYSTEMS ITX-P-C444
#@SOC: i.MX8MQ
#@DESCRIPTION: Machine configuration for WINSYSTEMS ITX-P-C444
#              following the EBBR requirements (UEFI)
#@MAINTAINER:  bkrieger@winsystems.com

require conf/machine/imx8mq-itx-p-c444.conf

MACHINEOVERRIDES .= ":imx8mq-itx-p-c444:imx8mq-itx-p-c444-ebbr"
MACHINE_FEATURES += "efi ebbr"
```

## conf/machine/imx8mq-itx-p-c444-sd.conf
```bitbake
#@TYPE: Machine
#@NAME: WINSYSTEMS ITX-P-C444-SD
#@SOC: i.MX8MQ
#@DESCRIPTION: Machine configuration for WINSYSTEMS ITX-P-C444 booting from SD card
#@MAINTAINER:  bkrieger@winsystems.com

require conf/machine/imx8mq-itx-p-c444.conf

MACHINEOVERRIDES .= ":imx8mq-itx-p-c444:imx8mq-itx-p-c444-sd"
```

## conf/machine/imx8mq-itx-p-c444.conf
```bitbake
#@TYPE: Machine
#@NAME: WINSYSTEMS ITX-P-C444
#@SOC: i.MX8MQ
#@DESCRIPTION: Machine configuration for WINSYSTEMS ITX-P-C444
#@MAINTAINER:  bkrieger@winsystems.com

MACHINEOVERRIDES =. "mx8:mx8m:mx8mq:imx8mqevk:"

require conf/machine/include/imx-base.inc
require conf/machine/include/tune-cortexa53.inc

KMACHINE ?= "imx8mqevk"

IMX_DEFAULT_BSP = "nxp"

MACHINE_FEATURES += "pci wifi bluetooth optee qca6174"

MACHINE_SOCARCH_FILTER_append_mx8mq = " virtual/libopenvg virtual/libgles1 virtual/libgles2 virtual/egl virtual/mesa virtual/libgl virtual/libg2d"

# Dont use any DTB from kernel
KERNEL_DEVICETREE = ""
# Instead use DTB from the lmp-device-tree recipe
PREFERRED_PROVIDER_virtual/dtb ?= "lmp-device-tree"
# Make sure we build the devicetree and add it to lmp-base builds
EXTRA_IMAGEDEPENDS_append = " virtual/dtb "
IMAGE_BOOT_FILES_append_lmp-base = " \
    devicetree/freescale_imx8mq-itx-p-c444.dtb:imx8mq-itx-p-c444.dtb \
    devicetree/freescale_imx8mq-itx-p-c444-lvds-auo.dtb:imx8mq-itx-p-c444-lvds-auo.dtb \
"

UBOOT_CONFIG ??= "sd"
UBOOT_CONFIG[sd] = "imx8mq_evk_config,sdcard"
UBOOT_CONFIG[mfgtool] = "imx8mq_evk_config"
SPL_BINARY = "spl/u-boot-spl.bin"

UBOOT_MACHINE ?= "imx8mq_evk_config"

#PREFERRED_PROVIDER_u-boot = "u-boot-imx"
OPTEE_BIN_EXT = "8mq"

# Set DDR FIRMWARE
DDR_FIRMWARE_NAME = "lpddr4_pmu_train_1d_imem.bin lpddr4_pmu_train_1d_dmem.bin lpddr4_pmu_train_2d_imem.bin lpddr4_pmu_train_2d_dmem.bin"

# Set u-boot DTB
UBOOT_DTB_NAME = "imx8mq-itx-p-c444-lvds-auo.dtb"

# Set imx-mkimage boot target
IMXBOOT_TARGETS = "flash_evk flash_evk_no_hdmi flash_dp_evk"

# Set Serial console
SERIAL_CONSOLES = "115200;ttymxc0"

LOADADDR = ""
UBOOT_SUFFIX = "bin"
UBOOT_MAKE_TARGET = ""
IMX_BOOT_SEEK = "33"

LICENSE_FLAGS_WHITELIST="commercial"
```

## conf/machine/include/lmp-partner-custom.inc
```bitbake
# LMP partner specific customizations (either replace or extend options as defined by meta-lmp)

# Use mmcblk1p2 as root (SD card)
OSTREE_KERNEL_ARGS:imx8mq-itx-p-c444-sd ?= "console=tty1 console=ttymxc0,115200 earlycon=ec_imx6q,0x30860000,115200 root=/dev/mmcblk1p2 rootfstype=ext4"

# SystemReady settings
UBOOT_SIGN_ENABLE:sota:imx8mq-itx-p-c444-ebbr = ""
KERNEL_IMAGETYPE:sota:imx8mq-itx-p-c444-ebbr ?= "Image"
KERNEL_CLASSES:sota:imx8mq-itx-p-c444-ebbr ?= ""
EFI_PROVIDER:imx8mq-itx-p-c444-ebbr ?= "grub-efi"
OSTREE_BOOTLOADER:imx8mq-itx-p-c444-ebbr ?= "grub"
IMAGE_EFI_BOOT_FILES:sota:imx8mq-itx-p-c444-ebbr ?= "${@make_efi_dtb_boot_files(d)}"
WKS_FILE:sota:imx8mq-itx-p-c444_imx8mq-itx-p-c444-ebbr = "efidisk-sota.wks"

# Use imx-boot + u-boot.itb WIC file
WKS_FILE:imx8mq-itx-p-c444 ?= "sdimage-imx8m-spl-fit.wks.in"
WKS_FILE:sota:imx8mq-itx-p-c444 ?= "sdimage-imx8m-spl-fit-sota.wks.in"
```
